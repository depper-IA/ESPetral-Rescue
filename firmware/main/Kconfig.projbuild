## firmware/main/Kconfig.projbuild
```kconfig
menu "CALI CSI Node Configuration"

    config CALI_LED_GPIO
        int "GPIO pin for onboard LED indicator"
        range 0 48
        help
            GPIO number used for the LED indicator.

            Defaults by chip (definidos en sdkconfig.defaults.<target>):
              ESP32-C3 (DevKitM-1 / Super Mini): 8
              ESP32-C6 (Super Mini):            8
              ESP32-S3 (Zero / Super Mini):     21
              ESP32-S3 (DevKitC-1 RGB):         48 (requiere driver WS2812)

            Si tu placa difiere del default del chip, ajustá este valor
            vía `idf.py menuconfig` o `idf.py -DCONFIG_LED_GPIO=N build`.

            Cambiar este valor NO afecta la lógica de detección CSI —
            solo cambia qué GPIO se activa como indicador visual.

endmenu
```

## firmware/mama-esp32-s3/main/Kconfig.projbuild
```kconfig
menu "CALI CSI Node Configuration"

    config CALI_LED_GPIO
        int "GPIO pin for onboard LED indicator"
        range 0 48
        default 8
        help
            GPIO number used for the LED indicator.

            Default explícito de este symbol: 8 (compatible con C3/C6
            Super Mini). Se usa SOLO si ningún sdkconfig.defaults.<target>
            lo sobreescribe — nunca debería quedar vacío en un build real.

            Defaults por chip (definidos en sdkconfig.defaults.<target>,
            tienen prioridad sobre el default de este symbol):
              ESP32-C3 (DevKitM-1 / Super Mini): 8
              ESP32-C6 (Super Mini):            8
              ESP32-S3 (Zero / Super Mini):     21
              ESP32-S3 (DevKitC-1 RGB):         48 (requiere driver WS2812)

            Si tu placa difiere del default del chip, ajustá este valor
            vía `idf.py menuconfig` o `idf.py -DCONFIG_CALI_LED_GPIO=N build`.

            Cambiar este valor NO afecta la lógica de detección CSI —
            solo cambia qué GPIO se activa como indicador visual.

endmenu
```

## firmware/satelite-esp32-c3/sdkconfig.defaults
```kconfig
CONFIG_IDF_TARGET="esp32c3"

# Partition table (4MB Flash estandar)
CONFIG_PARTITION_TABLE_CUSTOM=y
CONFIG_PARTITION_TABLE_CUSTOM_FILENAME="partitions.csv"

# Flash size 4MB
CONFIG_ESPTOOLPY_FLASHSIZE_4MB=y
CONFIG_ESPTOOLPY_FLASHSIZE="4MB"

# CPU freq por defecto del C3 (160 MHz maximo)
CONFIG_ESP32C3_DEFAULT_CPU_FREQ_160=y
CONFIG_XTAL_FREQ_40=y

# LED GPIO por defecto (GPIO 8 en DevKitM-1 / Super Mini)
CONFIG_CALI_LED_GPIO=8

# Wi-Fi & CSI
CONFIG_ESP_WIFI_MODE_STA=y
CONFIG_ESP_WIFI_CSI_ENABLED=y
CONFIG_WIFI_COUNTRY_CODE="01"

# NVS
CONFIG_NVS_ENCRYPTION=n

# MQTT
CONFIG_MQTT_PROTOCOL_5=n

# Power management
CONFIG_PM_ENABLE=y
CONFIG_PM_LIGHT_SLEEP_CALLBACKS=y
CONFIG_FREERTOS_USE_TICKLESS_IDLE=y

# Logging
CONFIG_LOG_DEFAULT_LEVEL_INFO=y
CONFIG_LOG_MAXIMUM_LEVEL_DEBUG=y
```
